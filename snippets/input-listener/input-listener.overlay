&pointing_listener {
    status = "okay";
    device = <&pointing_device>;

    scroll_layer: scroll_layer {
        layers = <5>;
        input-processors = <&zip_xy_to_scroll_mapper>, <&zip_scroll_scaler 3 8>;
    };
};
